## config/boards/shields/demeter/Kconfig.defconfig
```kconfig
if SHIELD_DEMETER_LEFT

config ZMK_KEYBOARD_NAME
	default "DEMETER"

endif


if SHIELD_DEMETER_RIGHT

config ZMK_KEYBOARD_NAME
	default "DEMETER_Right"
config ZMK_SPLIT_BLE_ROLE_CENTRAL
	default y

endif


if SHIELD_DEMETER_RIGHT || SHIELD_DEMETER_LEFT

config ZMK_SPLIT
	default y


endif
```
