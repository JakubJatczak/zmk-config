## config/boards/shields/demeter/Kconfig.shield
```kconfig
# Copyright (c) 2020 Pete Johanson
# SPDX-License-Identifier: MIT

config SHIELD_DEMETER_LEFT
	def_bool $(shields_list_contains,demeter_left)

config SHIELD_DEMETER_RIGHT
	def_bool $(shields_list_contains,demeter_right)
```

## config/west.yml
```yaml
manifest:
  remotes:
    - name: zmkfirmware
      url-base: https://github.com/zmkfirmware
    # Additional modules containing boards/shields/custom code can be listed here as well
    # See https://docs.zephyrproject.org/3.2.0/develop/west/manifest.html#projects
    - name: jakubjatczak
      url-base: https://github.com/jakubjatczak
  projects:
    - name: zmk
      remote: jakubjatczak
      revision: add_demeter
      import: app/west.yml
  self:
    path: config
```
