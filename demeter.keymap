#include <behaviors.dtsi>
#include <dt-bindings/zmk/keys.h>
#include "zmk-nodefree-config/helper.h"
#include "zmk-nodefree-config/keypos_def/keypos_34keys.h"

#define DEF 0
#define LSYM 1
#define RSYM 2
#define NAV 3
#define I3 4

#define KEYS_L LT0 LT1 LT2 LT3 LT4 LM0 LM1 LM2 LM3 LM4 LB0 LB1 LB2 LB3 LB4  // left-hand keys
#define KEYS_R RT0 RT1 RT2 RT3 RT4 RM0 RM1 RM2 RM3 RM4 RB0 RB1 RB2 RB3 RB4  // right-hand keys
#define THUMBS LH1 LH0 RH0 RH1                                              // thumb keys

lrep: layer_repeat {
    compatible = "zmk,behavior-hold-tap";
    label = "LAYER_HOLD_REPEAT_TAP";
    flavor = "hold-preferred"
    #binding cells = <2>;
    bindings = <&mo>, <&key_repeat>;
    tapping-term-ms = <200>;
}


/* left-hand HRMs */
ZMK_HOLD_TAP(hml,
    flavor = "balanced";
    tapping-term-ms = <280>;
    quick-tap-ms = <175>;                // repeat on tap-into-hold
    require-prior-idle-ms = <150>;
    bindings = <&kp>, <&kp>;
    hold-trigger-key-positions = <KEYS_R THUMBS>;
    hold-trigger-on-release;             // delay positional check until key-release
)

/* right-hand HRMs */
ZMK_HOLD_TAP(hmr,
    flavor = "balanced";
    tapping-term-ms = <280>;
    quick-tap-ms = <175>;                // repeat on tap-into-hold
    require-prior-idle-ms = <150>;
    bindings = <&kp>, <&kp>;
    hold-trigger-key-positions = <KEYS_L THUMBS>;
    hold-trigger-on-release;             // delay positional check until key-release
)

/ {
    combos {
        compatible = "zmk,combos";

        q {
            bindings = <&kp Q>;
            key-positions = <3 2>;
            layers = <DEF>;
        };

        backspace {
            bindings = <&kp BACKSPACE>;
            key-positions = <3 4>;
            layers = <DEF>;
        };

        dollar {
            bindings = <&kp DOLLAR>;
            key-positions = <1 2>;
        };

        esc {
            bindings = <&kp ESCAPE>;
            key-positions = <8 19>;
            layers = <DEF>;
        };

        lock {
            bindings = <&kp RG(PAUSE_BREAK)>;
            key-positions = <10 1 8 19>;
            layers = <DEF>;
        };

        symbolReturt {
            bindings = <&kp RETURN>;
            key-positions = <17 18>;
            layers = <RSYM>;
        };

        symbolSpace {
            bindings = <&kp SPACE>;
            key-positions = <11 12>;
            layers = <LSYM>;
        };

        delete {
            bindings = <&kp DELETE>;
            key-positions = <10 1>;
            layers = <DEF>;
        };

        apostrophe {
            bindings = <&kp SQT>;
            key-positions = <7 8>;
            layers = <ALL>;
        };

        colon {
            bindings = <&kp COLON>;
            key-positions = <6 7>;
            layers = <ALL>;
        };

        NumWord {
            bindings = <&none>;
            key-positions = <2 7>;
        };

        CapsWord {
            bindings = <&caps_word>;
            key-positions = <23 26>;
        };

        altDot {
            bindings = <&kp LA(DOT)>;
            key-positions = <27 28>;
            layers = <DEF>;
        };
    };

    keymap {
        compatible = "zmk,keymap";

        Default {
            bindings = <
&none  &kp W  &kp F  &kp P      &kp B          &kp J      &kp L           &kp U      &kp Y    &none
&hml RGUI A  &hml RALT R  &hml RCTRL S  &hml RSHFT T      &kp G          &kp M      &hml RSHIFT N           &hmr RCTRL E      &hml RALT I    &hml RGUI O
&kp Z  &kp X  &kp C  &kp D      &kp V          &kp K      &kp H           &kp COMMA  &kp DOT  &kp FSLH
                     &lt NAV TAB  &lt RSYM SPACE    &lt LSYM RET  &lrep I3 0
            >;
        };

        LeftSombols {
            bindings = <
&kp LS(DLLR)   &kp LS(LBRC)  &kp LS(RBRC)  &kp LS(DQT)    &kp LS(PIPE)     &none  &none  &none  &none  &none
&kp LS(POUND)  &kp LS(LPAR)  &kp LS(RPAR)  &kp SEMI       &kp LS(TILDE)    &none  &kp N3  &kp N1  &kp N5  &kp N7
&kp LS(PRCNT)  &kp LBKT      &kp RBKT      &kp LS(CARET)  &kp BSLH         &none   &kp N9  &none  &none  &none
                                           &kp DEL        &kp SPACE        &none  &none
            >;
        };

        RightSymbols {
            bindings = <
&none  &none  &none  &none  &none    &kp LS(EXCL)  &kp LS(EXCL)  &kp LS(UNDER)  &kp LS(AT)    &none
&kp N6  &kp N4  &kp N0  &kp N2  &none    &kp LS(STAR)  &kp EQUAL     &kp LS(PIPE)   &kp LS(PLUS)  &kp MINUS
&none   &none  &none  &kp N8  &none    &kp LS(AMPS)  &kp GRAVE     &kp LS(LT)     &kp LS(GT)    &kp LS(QMARK)
                        &none  &none    &kp RET       &none
            >;
        };

        Navigation {
            bindings = <
&trans  &trans  &trans  &trans  &trans    &trans  &trans    &trans     &trans     &trans
&sk LGUI &sk LALT  &sk LCTRL  &sk LSHFT  &trans  &trans    &none   &kp LEFT  &kp DOWN   &kp UP     &kp RIGHT
&trans  &trans  &trans  &trans  &trans    &trans  &kp HOME  &kp PG_DN  &kp PG_UP  &kp END
                        &trans  &trans    &trans  &trans
            >;
        };

        i3 {
            bindings = <
&trans  &trans  &trans  &trans  &trans    &trans  &trans  &trans  &trans  &trans
&trans  &trans  &trans  &trans  &trans    &trans  &trans  &trans  &trans  &trans
&trans  &trans  &trans  &trans  &trans    &trans  &trans  &trans  &trans  &trans
                        &trans  &trans    &trans  &trans
            >;
        };
    };
};
